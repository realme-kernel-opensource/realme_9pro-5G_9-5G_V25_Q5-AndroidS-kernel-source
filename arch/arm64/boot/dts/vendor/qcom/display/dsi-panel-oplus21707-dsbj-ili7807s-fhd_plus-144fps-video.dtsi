&mdss_mdp {
	dsi_oplus21707_dsbj_ili7807s_fhd_plus_144fps_video: qcom,mdss_dsi_oplus21707_dsbj_ili7807s_fhd_plus_144fps_video {
		qcom,mdss-dsi-panel-name =
			"dsjm ili7807s 21707 fhd plus mipi panel with DSC";
		qcom,mdss-dsi-panel-type = "dsi_video_mode";
		qcom,dsi-ctrl-num = <0>;
		qcom,dsi-phy-num = <0>;
		qcom,mdss-dsi-virtual-channel-id = <0>;
		qcom,mdss-dsi-stream = <0>;
		qcom,mdss-dsi-bpp = <24>;
		qcom,mdss-dsi-color-order = "rgb_swap_rgb";
		qcom,mdss-dsi-underflow-color = <0xff>;
		qcom,mdss-dsi-border-color = <0>;

		qcom,mdss-dsi-traffic-mode = "burst_mode";
		qcom,mdss-dsi-bllp-power-mode;
		qcom,mdss-dsi-bllp-eof-power-mode;
		qcom,mdss-dsi-lane-0-state;
		qcom,mdss-dsi-lane-1-state;
		qcom,mdss-dsi-lane-2-state;
		qcom,mdss-dsi-lane-3-state;
		qcom,mdss-dsi-dma-trigger = "trigger_sw";
		qcom,mdss-dsi-mdp-trigger = "none";
		qcom,mdss-dsi-reset-sequence = <1 5>, <0 5>, <1 5>;

		qcom,mdss-dsi-wr-mem-start = <0x2C>;
		qcom,mdss-dsi-wr-mem-continue = <0x3C>;

		qcom,bl-update-flag = "delay_until_first_frame";
		qcom,mdss-dsi-init-delay-us = <1000>;
		qcom,mdss-dsi-lp11-init;
		qcom,ulps-enabled;
		qcom,suspend-ulps-enabled;

		qcom,mdss-dsi-te-pin-select = <1>;
		qcom,mdss-dsi-te-dcs-command = <1>;
		qcom,mdss-dsi-te-check-enable;
		qcom,mdss-dsi-te-using-te-pin;

		qcom,mdss-pan-physical-width-dimension = <71>;
		qcom,mdss-pan-physical-height-dimension = <152>;

		qcom,mdss-dsi-display-timings {
			timing@0 {
				//qcom,mdss-mdp-transfer-time-us = <7000>;
				qcom,mdss-dsi-panel-framerate = <120>;
				qcom,mdss-dsi-panel-width = <1080>;
				qcom,mdss-dsi-panel-height = <2412>;
				qcom,mdss-dsi-h-front-porch = <120>;
				qcom,mdss-dsi-h-back-porch = <117>;
				qcom,mdss-dsi-h-pulse-width = <20>;
				qcom,mdss-dsi-h-sync-skew = <0>;
				qcom,mdss-dsi-v-back-porch = <36>;
				qcom,mdss-dsi-v-front-porch = <40>;
				qcom,mdss-dsi-v-pulse-width = <4>;
				qcom,mdss-dsi-on-command = [
					39 01 00 00 00 00 04 FF 78 07 06
					15 01 00 00 00 00 02 08 20
					39 01 00 00 00 00 04 FF 78 07 03
					15 01 00 00 00 00 02 81 14  //step
					15 01 00 00 00 00 02 82 15  //step
					15 01 00 00 00 00 02 83 20
					15 01 00 00 00 00 02 84 01

					39 01 00 00 00 00 04 FF 78 07 03
					15 01 00 00 00 00 02 88 DB  //CC Black 80%->86%
					15 01 00 00 00 00 02 89 E5  //grey 89.84%
					15 01 00 00 00 00 02 8A ED  //fruit 92.97%
					15 01 00 00 00 00 02 8B EF
					15 01 00 00 00 00 02 B3 E5  //desktop 89.84%
					15 01 00 00 00 00 02 A6 E6	//aw duty1 low
					15 01 00 00 00 00 02 AC FA  //white 98%   aw duty3 low

					15 01 00 00 00 00 02 A7 F3  //E5  //aw duty1 med
					15 01 00 00 00 00 02 AD E3  //E0  //white aw duty3 med
					15 01 00 00 00 00 02 8C AD  //9B black 60.94%->68%
					15 01 00 00 00 00 02 8D B1  //
					15 01 00 00 00 00 02 8E B4  //
					15 01 00 00 00 00 02 8F B7  //
					15 01 00 00 00 00 02 90 BB  //grey 69.92%->73.44%
					15 01 00 00 00 00 02 91 BF  //
					15 01 00 00 00 00 02 92 C3  //
					15 01 00 00 00 00 02 93 C7  //BA fruit 73%->78.1%
					15 01 00 00 00 00 02 94 CA
					15 01 00 00 00 00 02 95 D5
					15 01 00 00 00 00 02 B4 D9  //desktop 85.2%

					15 01 00 00 00 00 02 A8 EE  //E5  //aw duty1 hi
					15 01 00 00 00 00 02 AE DE  //D3  //white aw duty3 hi
					15 01 00 00 00 00 02 96 90  //70 black 44.14%->56.64%
					15 01 00 00 00 00 02 97 97  //L4-L19
					15 01 00 00 00 00 02 98 99
					15 01 00 00 00 00 02 99 9F
					15 01 00 00 00 00 02 9A A3  //grey 64%
					15 01 00 00 00 00 02 9B A6
					15 01 00 00 00 00 02 9C A9
					15 01 00 00 00 00 02 9D BD  //AD fruit 67.97%->74.2%
					15 01 00 00 00 00 02 9E C2
					15 01 00 00 00 00 02 9F CC
					15 01 00 00 00 00 02 B5 D0  //desktop 81%

					15 01 00 00 00 00 02 A0 C0  //aw thre1 en+low
					15 01 00 00 00 00 02 A1 7E  //aw thre1 med
					15 01 00 00 00 00 02 A2 7E  //aw thre1 hi
					15 01 00 00 00 00 02 B6 00  //boost l
					15 01 00 00 00 00 02 B7 D0  //boost m
					15 01 00 00 00 00 02 B8 D0  //boost h
					15 01 00 00 00 00 02 B1 66  //hsat thre m
					15 01 00 00 00 00 02 B2 66  //hsat thre h
					15 01 00 00 00 00 02 86 6C  //thre m
					15 01 00 00 00 00 02 87 6C  //thre h

					39 01 00 00 00 00 04 FF 78 07 06 //add 0104
					15 01 00 00 00 00 02 3E E2
					39 01 00 00 00 00 04 FF 78 07 00
					15 01 00 00 00 00 02 53 24
					15 01 00 00 00 00 02 55 01
					15 01 00 00 00 00 02 35 00
					05 01 00 00 3F 00 01 11

					39 01 00 00 00 00 04 FF 78 07 17
					39 01 00 00 00 00 86 20
						00 00 00 00 00 11 00 00 89 30
						80 09 6C 04 38 00 0C 02 1C 02
						1C 02 00 02 0E 00 20 01 1F 00
						07 00 0C 08 BB 08 7A 18 00 10
						F0 03 0C 20 00 06 0B 0B 33 0E
						1C 2A 38 46 54 62 69 70 77 79
						7B 7D 7E 01 02 01 00 09 40 09
						BE 19 FC 19 FA 19 F8 1A 38 1A
						78 1A B6 2A F6 2B 34 2B 74 3B
						74 6B F4 00 00 00 00 00 00 00
						00 00 00 00 00 00 00 00 00 00
						00 00 00 00 00 00 00 00 00 00
						00 00 00 00 00 00 00 00 00 00
						00 00 00
					39 01 00 00 00 00 04 FF 78 07 0E
					15 01 00 00 00 00 02 21 2E
					15 01 00 00 00 00 02 23 2E
					15 01 00 00 00 00 02 41 17
					15 01 00 00 00 00 02 43 17
					// add start 1124
					39 01 00 00 00 00 04 FF 78 07 0C
					15 01 00 00 00 00 02 00 3F
					15 01 00 00 00 00 02 01 F0
					15 01 00 00 00 00 02 02 3F
					15 01 00 00 00 00 02 03 F8
					39 01 00 00 00 00 04 FF 78 07 1E
					15 01 00 00 00 00 02 A4 00
					15 01 00 00 00 00 02 A5 82
					15 01 00 00 00 00 02 A6 82
					15 01 00 00 00 00 02 A7 52
					15 01 00 00 00 00 02 AA 00
					// add end 1124
					39 01 00 00 00 00 04 FF 78 07 02
					15 01 00 00 00 00 02 1B 00	// FR_sel:FPS/TP [00:120/180 01:144/144 02:60/180]
					39 01 00 00 00 00 04 FF 78 07 04
					15 01 00 00 00 00 02 BD 01	// GRAM Arbiter reset

					39 01 00 00 00 00 04 FF 78 07 00
					05 01 00 00 03 00 01 29
					];

				qcom,mdss-dsi-off-command = [
					39 01 00 00 01 00 04 FF 78 07 00
					05 01 00 00 14 00 01 28
					05 01 00 00 53 00 01 10];
				qcom,mdss-dsi-post-panel-on-command =[
					39 01 00 00 00 00 04 FF 78 07 00
				];
				qcom,mdss-dsi-cabc-off-command = [
					39 01 00 00 00 00 04 FF 78 07 00
					15 01 00 00 00 00 02 55 00];
				qcom,mdss-dsi-cabc-ui-command = [
					39 01 00 00 00 00 04 FF 78 07 00
					15 01 00 00 00 00 02 55 01];
				qcom,mdss-dsi-cabc-still-image-command = [
					39 01 00 00 00 00 04 FF 78 07 00
					15 01 00 00 00 00 02 55 02];
				qcom,mdss-dsi-cabc-video-command = [
					39 01 00 00 00 00 04 FF 78 07 00
					15 01 00 00 00 00 02 55 03];

				qcom,mdss-dsi-on-command-state = "dsi_lp_mode";
				qcom,mdss-dsi-off-command-state = "dsi_lp_mode";
				qcom,mdss-dsi-post-panel-on-command-state="dsi_lp_mode";
				qcom,mdss-dsi-cabc-off-command-state = "dsi_lp_mode";
				qcom,mdss-dsi-cabc-ui-command-state = "dsi_lp_mode";
				qcom,mdss-dsi-cabc-still-image-command-state = "dsi_lp_mode";
				qcom,mdss-dsi-cabc-video-command-state = "dsi_lp_mode";

				qcom,compression-mode = "dsc";
				qcom,mdss-dsc-slice-height = <12>;
				qcom,mdss-dsc-slice-width = <540>;
				qcom,mdss-dsc-slice-per-pkt = <2>;
				qcom,mdss-dsc-bit-per-component = <8>;
				qcom,mdss-dsc-bit-per-pixel = <8>;
				qcom,mdss-dsc-block-prediction-enable;
			};
		};
	};
};

&dsi_oplus21707_dsbj_ili7807s_fhd_plus_144fps_video {
	oplus,mdss-dsi-manufacture = "DSJM";
	oplus,mdss-dsi-vendor-name = "JDI_ILI7807S";
	oplus,mdss-dsi-pre-bl-delay-enabled;
	oplus,mdss-dsi-pre-bl-delay-ms = <30>;
	oplus,mdss-dsi-cabc-enabled;
	oplus,mdss-dsi-lp-config-flag;
	oplus,lcd_switch_enabled;
	oplus,dfps-idle-off;
	qcom,panel-supply-entries = <&dsi_panel_pwr_supply_labibb>;
	qcom,mdss-dsi-bl-pmic-control-type = "bl_ctrl_dcs";
	qcom,mdss-dsi-bl-min-level = <22>;
	qcom,mdss-dsi-bl-max-level = <4095>;
	qcom,mdss-brightness-max-level = <4095>;
	qcom,mdss-dsi-bl-normal-max-level = <3320>;
	qcom,mdss-brightness-normal-max-level = <3320>;
	qcom,mdss-brightness-default-level = <891>;
	qcom,platform-te-gpio = <&tlmm 23 0>;
	qcom,platform-reset-gpio = <&tlmm 100 0>;
	qcom,dsi-select-clocks = "mux_byte_clk0", "mux_pixel_clk0",
		"src_byte_clk0", "src_pixel_clk0",
		"shadow_byte_clk0", "shadow_pixel_clk0";

	qcom,esd-check-enabled;
	qcom,mdss-dsi-panel-status-check-mode = "reg_read";
	qcom,mdss-dsi-panel-status-command = [06 01 00 01 00 00 01 09];
	qcom,mdss-dsi-panel-status-command-state = "dsi_lp_mode";
	qcom,mdss-dsi-panel-status-value = <0x80 0x03 0x06>;
	qcom,mdss-dsi-panel-status-read-length = <3>;

	qcom,mdss-dsi-pan-enable-dynamic-fps;
	qcom,mdss-dsi-pan-fps-update = "dfps_immediate_porch_mode_vfp";
	qcom,dsi-supported-dfps-list = <120 90 60 50 48 30>;
	qcom,mdss-dsi-qsync-min-refresh-rate = <30>;

	qcom,dsi-dyn-clk-enable;
	qcom,dsi-dyn-clk-type = "constant-fps-adjust-hfp";
	qcom,dsi-dyn-clk-list = <1107046080 1117009376>;

	oplus,dsi-brightness-remapping = <21    0>,
            <22    14>,
            <246   60>,
            <688   106>,
            <920   200>,
            <1096  295>,
            <1244  398>,
            <1373  484>,
            <1489  578>,
            <1596  673>,
            <1694  767>,
            <1786  862>,
            <1872  956>,
            <1954  1051>,
            <2032  1145>,
            <2107  1240>,
            <2178  1334>,
            <2247  1429>,
            <2313  1523>,
            <2377  1618>,
            <2440  1712>,
            <2500  1807>,
            <2559  1901>,
            <2616  1996>,
            <2671  2090>,
            <2725  2185>,
            <2778  2279>,
            <2830  2374>,
            <2881  2468>,
            <2930  2563>,
            <2979  2657>,
            <3027  2752>,
            <3074  2846>,
            <3119  2941>,
            <3165  3035>,
            <3209  3130>,
            <3253  3224>,
            <3320  3320>,
            <4095  4095>;

	qcom,mdss-dsi-t-clk-post = <0x0F>;
	qcom,mdss-dsi-t-clk-pre = <0x1E>;
	qcom,mdss-dsi-display-timings {
		timing@0 {
			qcom,mdss-dsi-panel-phy-timings = [00 24 0A 0A 1A 18 0A
				0A 09 02 04 00 1E 0F];
			qcom,display-topology = <1 1 1>;
			qcom,default-topology-index = <0>;
		};
	};
};

&dsi_oplus21707_dsbj_ili7807s_fhd_plus_144fps_video {
	qcom,panel_voltage_vddi_name = "vddio";
	qcom,panel_voltage_vddi = <0 1650000 1800000 1950000>;
	qcom,panel_voltage_vddr_name = "vddio";
	qcom,panel_voltage_vddr = <1 1650000 1800000 1950000>;
};

